#include <behaviors.dtsi>
#include <dt-bindings/zmk/keys.h>

/ {
    keymap {
        compatible = "zmk,keymap";

        default_layer {
            // 物理配置: D0 D1 D2 D3 の一列横並び
            // 割り当て:  ←   ↑   ↓   →
            bindings = <
                &kp LEFT  &kp UP  &kp DOWN  &kp RIGHT
            >;
        };
    };
};
